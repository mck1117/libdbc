VERSION ""

NS_ :

BS_:

BU_:

BO_ 456 TestMessage: 3 Vector__XXX
 SG_ SignalMux M : 0|8@1+ (7,8) [9|10] "test unit" Vector__XXX
 SG_ SignalMuxA m5 : 8|8@1+ (1,0) [0|0] "" Vector__XXX
 SG_ HugeMEquals m9999999 : 16|8@1+ (1,0) [0|0] "" Vector__XXX
