VERSION ""

NS_ :

BS_:

BU_:

BO_ 123 TestMessage: 4 Vector__XXX
 SG_ TestSignal : 5|6@1+ (7,8) [9|10] "test unit" Vector__XXX

CM_ BO_ 123 "Test Message Comment";
CM_ SG_ 123 TestSignal "Test Signal Comment";
